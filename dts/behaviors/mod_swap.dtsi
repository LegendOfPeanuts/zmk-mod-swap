#include <dt-bindings/zmk/keys.h>

/ {
    behaviors {
        /omit-if-no-ref/ num_word: num_word {
            compatible = "zmk,behavior-mod-swap";
            #binding-cells = <0>;
            first_mod = <(MOD_LCTL | MOD_RCTL)>;
            second_mod = <(MOD_LGUI | MOD_RGUI)>;
        };
    };
};

